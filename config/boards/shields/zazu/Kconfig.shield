## config/boards/shields/zazu/Kconfig.shield
```kconfig
# Copyright (c) 2020 The ZMK Contributors
# SPDX-License-Identifier: MIT

config SHIELD_COCOT46P
    def_bool $(shields_list_contains,cocot46p)
```
